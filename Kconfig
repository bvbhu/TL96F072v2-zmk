## Kconfig
```kconfig
# Copyright (c) 2026 bvbhu
# SPDX-License-Identifier: MIT

config WS2812_GPIO_STM32
    bool "WS2812 GPIO bit-bang driver for STM32"
    select LED_STRIP
    help
      自定义 WS2812 GPIO bit-bang 驱动，适用于 STM32 系列。
      Zephyr 4.1.0 内置的 ws2812_gpio 仅支持 NRF 系列，本驱动
      使用 STM32 GPIO BSRR 寄存器实现时序控制。
```

## boards/talo/tl96/Kconfig.defconfig
```kconfig
# TL96 keyboard configuration
# Copyright (c) 2026 bvbhu
# SPDX-License-Identifier: MIT

if BOARD_TL96

# WS2812_GPIO_STM32 符号定义见项目根 Kconfig，启用见 tl96_defconfig

config SOC
    default "stm32f072xb"

config SOC_FAMILY
    default "st_stm32"

config SOC_SERIES
    default "stm32f0x"

config ZMK_KEYBOARD_NAME
    default "TL96"

config ZMK_USB
    default y

endif # BOARD_TL96
```

## boards/talo/tl96/Kconfig.tl96
```kconfig
# TL96 keyboard configuration
# Copyright (c) 2026 bvbhu
# SPDX-License-Identifier: MIT

config BOARD_TL96
    bool "TL96"
    select SOC_STM32F072XB
```

## boards/talo/tl96/board.yml
```yaml
board:
  name: tl96
  vendor: talo
  socs:
    - name: stm32f072xb
      variants:
        - name: zmk
```

## config/west.yml
```yaml
manifest:
  defaults:
    revision: main
  remotes:
    - name: zmkfirmware
      url-base: https://github.com/zmkfirmware
    - name: bvbhu-zmk-qmk-rgb-matrix
      url-base: https://github.com/bvbhu
  projects:
    - name: zmk
      remote: zmkfirmware
      import: app/west.yml
    - name: zmk-qmk-rgb-matrix
      remote: bvbhu-zmk-qmk-rgb-matrix
      revision: main
      path: modules/rgb-matrix
  self:
    path: config
```

## dts/bindings/behaviors/zmk,behavior-bvbhu.yaml
```yaml
# Copyright (c) 2026 bvbhu
# SPDX-License-Identifier: MIT

description: BVBHU Unified Custom Behavior

compatible: "zmk,behavior-bvbhu"

include: one_param.yaml

properties: {}
```

## dts/bindings/led_strip/bvbhu,ws2812-gpio-stm32.yaml
```yaml
# Copyright (c) 2026 bvbhu
# SPDX-License-Identifier: MIT

description: BVBHU WS2812 GPIO bit-bang driver for STM32

compatible: "bvbhu,ws2812-gpio-stm32"

include: base.yaml

properties:
  chain-length:
    type: int
    required: true
    description: Number of LEDs in the strip

  gpios:
    type: phandle-array
    required: true
    description: GPIO pin connected to the WS2812 data line

  color-mapping:
    type: array
    required: true
    description: Channel ordering (e.g. GRB)

  reset-delay:
    type: int
    default: 50
    description: Reset delay in microseconds
```
